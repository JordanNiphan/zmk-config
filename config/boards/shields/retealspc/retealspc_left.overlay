#include "retealspc.dtsi"

&kscan0 {
    col-gpios
        = <&pro_micro 21 GPIO_ACTIVE_HIGH>Q
        , <&pro_micro 14 GPIO_ACTIVE_HIGH>F
        , <&pro_micro 10 GPIO_ACTIVE_HIGH>B
        , <&pro_micro 16 GPIO_ACTIVE_HIGH>P
        , <&pro_micro 18 GPIO_ACTIVE_HIGH>W
        ;
    row-gpios
        = <&pro_micro 4 (GPIO_ACTIVE_HIGH | GPIO_PULL_DOWN)>
        , <&pro_micro 6 (GPIO_ACTIVE_HIGH | GPIO_PULL_DOWN)>
        , <&pro_micro 5 (GPIO_ACTIVE_HIGH | GPIO_PULL_DOWN)>           
        , <&pro_micro 7 (GPIO_ACTIVE_HIGH | GPIO_PULL_DOWN)>
        ;
};