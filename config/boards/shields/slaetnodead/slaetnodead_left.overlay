#include "slaetnodead.dtsi"

&kscan0 {
   compatible = "zmk,kscan-gpio-matrix";
    wakeup-source;
    diode-direction = "col2row";
    
    col-gpios
        = <&pro_micro 10 GPIO_ACTIVE_HIGH> 
        , <&pro_micro 16 GPIO_ACTIVE_HIGH> 
        , <&pro_micro 14 GPIO_ACTIVE_HIGH> 
        , <&pro_micro 15 GPIO_ACTIVE_HIGH> 
        , <&pro_micro 18 GPIO_ACTIVE_HIGH> 
        ;
    row-gpios
        = <&pro_micro 6 (GPIO_ACTIVE_HIGH | GPIO_PULL_DOWN)>
        , <&pro_micro 7 (GPIO_ACTIVE_HIGH | GPIO_PULL_DOWN)>           
        , <&pro_micro 3 (GPIO_ACTIVE_HIGH | GPIO_PULL_DOWN)>
        , <&pro_micro 4 (GPIO_ACTIVE_HIGH | GPIO_PULL_DOWN)>
        ;
};  