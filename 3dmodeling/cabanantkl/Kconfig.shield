## 3dmodeling/cabanantkl/Kconfig.shield
```kconfig
config SHIELD_CABANATKL_LEFT
    def_bool $(shields_list_contains,cabanatkl_left)

config SHIELD_CABANATKL_RIGHT
    def_bool $(shields_list_contains,cabanatkl_right)
```

## 3dmodeling/reteals/Kconfig.defconfig
```kconfig
if SHIELD_RETEALS_RIGHT

config ZMK_KEYBOARD_NAME
    default "RETEALS"

config ZMK_SPLIT_ROLE_CENTRAL
    default y

endif

if SHIELD_RETEALS_LEFT || SHIELD_RETEALS_RIGHT

config ZMK_SPLIT
    default y

endif
```

## 3dmodeling/reteals/Kconfig.shield
```kconfig
config SHIELD_RETEALS_LEFT
    def_bool $(shields_list_contains,reteals_left)

config SHIELD_RETEALS_RIGHT
    def_bool $(shields_list_contains,reteals_right)
```

## 3dmodeling/retealspc/Kconfig.defconfig
```kconfig
if SHIELD_RETEALSPC_LEFT

config ZMK_KEYBOARD_NAME
    default "RETEALSPC"

config ZMK_SPLIT_ROLE_CENTRAL
    default y

endif

if SHIELD_RETEALSPC_LEFT || SHIELD_RETEALSPC_RIGHT

config ZMK_SPLIT
    default y

endif
```

## 3dmodeling/slaethandwire/Kconfig.defconfig
```kconfig
if SHIELD_SLAETHANDWIRE_LEFT

config ZMK_KEYBOARD_NAME
    default "SLAETHANDWIRE"

config ZMK_SPLIT_ROLE_CENTRAL
    default y

endif

if SHIELD_SLAETHANDWIRE_LEFT || SHIELD_SLAETHANDWIRE_RIGHT

config ZMK_SPLIT
    default y

endif
```

## 3dmodeling/slaethandwire/Kconfig.shield
```kconfig
config SHIELD_SLAETHANDWIRE_LEFT
    def_bool $(shields_list_contains,slaethandwire_left)

config SHIELD_SLAETHANDWIRE_RIGHT
    def_bool $(shields_list_contains,slaethandwire_right)
```

## 3dmodeling/tklhandwire/Kconfig.defconfig
```kconfig
if SHIELD_TKLHANDWIRE_LEFT

config ZMK_KEYBOARD_NAME
    default "TKLHANDWIRE"

config ZMK_SPLIT_ROLE_CENTRAL
    default y

endif

if SHIELD_TKLHANDWIRE_LEFT || SHIELD_TKLHANDWIRE_RIGHT

config ZMK_SPLIT
    default y

endif
```

## 3dmodeling/tklhandwire/Kconfig.shield
```kconfig
config SHIELD_TKLHANDWIRE_LEFT
    def_bool $(shields_list_contains,tklhandwire_left)

config SHIELD_TKLHANDWIRE_RIGHT
    def_bool $(shields_list_contains,tklhandwire_right)
```

## config/boards/shields/Kconfig.defconfig
```kconfig
# Copyright (c) 2021 The ZMK Contributors
# SPDX-License-Identifier: MIT

if SHIELD_SLAET_LEFT

config ZMK_KEYBOARD_NAME
    default "Slaet The Bard"

config ZMK_SPLIT_ROLE_CENTRAL
    default y

endif

if SHIELD_SLAET_LEFT || SHIELD_SLAET_RIGHT

config ZMK_SPLIT
    default y

endif
```

## config/boards/shields/Kconfig.shield
```kconfig
# Copyright (c) 2021 The ZMK Contributors
# SPDX-License-Identifier: MIT

config SHIELD_SLAET_LEFT
    def_bool $(shields_list_contains,slaet_left)

config SHIELD_SLAET_RIGHT
    def_bool $(shields_list_contains,slaet_right)
```

## config/boards/shields/cabanantkl/Kconfig.defconfig
```kconfig
if SHIELD_CABANATKL_RIGHT

config ZMK_KEYBOARD_NAME
    default "CABANATKL"

config ZMK_SPLIT_ROLE_CENTRAL
    default y

endif

if SHIELD_CABANATKL_LEFT || SHIELD_CABANATKL_RIGHT

config ZMK_SPLIT
    default y

endif
```

## config/boards/shields/reteals/Kconfig.defconfig
```kconfig
if SHIELD_RETEALS_LEFT

config ZMK_KEYBOARD_NAME
    default "RETEALS"

config ZMK_SPLIT_ROLE_CENTRAL
    default y

endif

if SHIELD_RETEALS_LEFT 
config CONFIG_ZMK_SPLIT_ROLE_CENTRAL
    default y

config ZMK_SPLIT
    default y

if SHIELD_RETEALS_RIGHT
config CONFIG_ZMK_SPLIT_ROLE_CENTRAL
    default n

config ZMK_SPLIT
    default y

endif
```

## config/boards/shields/retealspc/Kconfig.shield
```kconfig
config SHIELD_RETEALSPC_LEFT
    def_bool $(shields_list_contains,retealspc_left)

config SHIELD_RETEALSPC_RIGHT
    def_bool $(shields_list_contains,retealspc_right)
```

## config/boards/shields/slaetcorne/Kconfig.shield
```kconfig
config SHIELD_SLAETCORNE_LEFT
    def_bool $(shields_list_contains,slaetcorne_left)

config SHIELD_SLAETCORNE_RIGHT
    def_bool $(shields_list_contains,slaetcorne_right)
```

## config/boards/shields/slaetnodead/Kconfig.defconfig
```kconfig
if SHIELD_SLAETNODEAD_LEFT

config ZMK_KEYBOARD_NAME
    default "SLAETNODEAD"

config ZMK_SPLIT_ROLE_CENTRAL
    default y

endif

if SHIELD_SLAETNODEAD_LEFT || SHIELD_SLAETNODEAD_RIGHT

config ZMK_SPLIT
    default y

endif
```

## config/boards/shields/slaetnodead/Kconfig.shield
```kconfig
config SHIELD_SLAETNODEAD_LEFT
    def_bool $(shields_list_contains,slaetnodead_left)

config SHIELD_SLAETNODEAD_RIGHT
    def_bool $(shields_list_contains,slaetnodead_right)
```

## config/west.yml
```yaml
manifest:
  remotes:
    - name: zmkfirmware
#      url-base: https://github.com/zmkfirmware
       url-base: https://github.com/ftc/zmk
  projects:
    - name: zmk
      remote: zmkfirmware
      revision: mouse-ftc   
#      revision: main
      import: app/west.yml
  self:
    path: config
```
